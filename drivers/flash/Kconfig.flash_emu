## drivers/flash/Kconfig.flash_emu
```kconfig
config FLASH_EMULATOR
	bool "Emulated FLASH driver"
	# select EEPROM
	help
	  Enable emulated (on eeprom) FLASH support. This mimics an external
	  FLASH on a eeprom device. 

config FLASH_EMULATOR_INIT_PRIORITY
	int "FLASH emulator init priority"
	default 76
	depends on FLASH_EMULATOR
	help
	  Sets the system initialisation priority for the flash emulator driver.
	  This should be greater than the init priority of the underlying 
	  eeprom driver.
```

## dts/bindings/mtd/zephyr,emu-flash.yaml
```yaml
description: Zephyr Emulated FLASH device

compatible: "zephyr,emu-flash"

include: base.yaml

properties:
    eeprom:
      type: phandle
      required: true
      description: The underlying EEPROM device used to store data
```
